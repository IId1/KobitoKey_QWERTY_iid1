## config/boards/shields/KobitoKey/Kconfig.defconfig
```kconfig
# 右（central / 親機）
if SHIELD_KOBITOKEY_RIGHT
config ZMK_KEYBOARD_NAME
    default "KobitoKey"
config ZMK_SPLIT_ROLE_CENTRAL
    default y
endif

# 左右共通
if SHIELD_KOBITOKEY_LEFT || SHIELD_KOBITOKEY_RIGHT
config ZMK_SPLIT
    default y
config ZMK_POINTING
    default y
config SPI
    default y
endif
```

## config/boards/shields/wrist_mouse/Kconfig.defconfig
```kconfig
if SHIELD_WRIST_MOUSE

config ZMK_KEYBOARD_NAME
    default "Wrist Mouse"

config ZMK_SPLIT
    default y

config ZMK_POINTING
    default y

config SPI
    default y

endif
```

## config/west.yml
```yaml
manifest:
  remotes:
    - name: zmkfirmware
      url-base: https://github.com/zmkfirmware
    - name: badjeff
      url-base: https://github.com/badjeff
    - name: hsgw
      url-base: https://github.com/hsgw
    - name: caksoylar  # <-- led
      url-base: https://github.com/caksoylar
    - name: george-norton
      url-base: https://github.com/george-norton

  projects:
    # ZMK 本体。公式の app/west.yml を取り込む
    - name: zmk
      remote: zmkfirmware
      revision: v0.3
      import: app/west.yml

    # PMW3610 ドライバ（左右トラックボール用）
    - name: zmk-pmw3610-driver
      remote: badjeff
      revision: zmk-0.3

    # PMW3360 ドライバ（wrist_mouse 子機用）
    - name: zmk-driver-pmw3360
      remote: george-norton
      revision: v0.3

    # Sensor-rotation
    - name: zmk-feature-sensor_rotation
      remote: hsgw
      revision: main

    # LED
    - name: zmk-rgbled-widget
      remote: caksoylar
      revision: v0.3

  self:
    path: config
```
